## CMakeLists.txt
```
# SPDX-License-Identifier: Apache-2.0

cmake_minimum_required(VERSION 3.28.0)

find_package(Zephyr REQUIRED HINTS $ENV{ZEPHYR_BASE})
project(digit_touch)

target_sources(app PRIVATE
  src/main.c
  src/inference.cc
  src/model_data.c
  src/preprocess.c
  src/selftest.c
  src/test_images.c
  src/ui.c
)
```

## Kconfig
```
# digit_touch — application-specific options

mainmenu "digit_touch"

# Intermediate variable: the comma in "zephyr,dtcm" would otherwise be taken
# as an argument separator
DT_CHOSEN_Z_DTCM := zephyr,dtcm

config APP_ARENA_IN_DTCM
	bool "TFLM tensor arena in DTCM"
	depends on $(dt_chosen_enabled,$(DT_CHOSEN_Z_DTCM))
	help
	  Place the tensor arena (model activations) in DTCM: RAM coupled
	  directly to the Cortex-M7 core, accessible with no wait states and
	  without going through the cache. By default, it is in SRAM1.

config APP_LAYER_PROFILING
	bool "Per-layer timing in the self-test"
	help
	  The startup self-test prints the number of cycles spent in each
	  operation of the model (CONV_2D, MAX_POOL_2D...).
	  Disabled by default: by shifting the placement of code in flash, it
	  slowed inference down by ~20 % (7.48 ms instead of 6.14 ms).
	  The proportions between layers remain valid, not the absolute times.

source "Kconfig.zephyr"
```

## prj.conf
```kconfig
CONFIG_MAIN_STACK_SIZE=8192
CONFIG_LOG=y
# Logs arrive in bursts (self-test, ASCII 28x28 image + 1568-character IMG
# line): larger buffer so none are lost
CONFIG_LOG_BUFFER_SIZE=8192

# Embedded AI: TensorFlow Lite Micro (C++) + CMSIS-NN optimized kernels
CONFIG_CPP=y
CONFIG_STD_CPP17=y
CONFIG_TENSORFLOW_LITE_MICRO=y
CONFIG_TENSORFLOW_LITE_MICRO_CMSIS_NN_KERNELS=y

# Display and touch
CONFIG_DISPLAY=y
CONFIG_DISPLAY_LOG_LEVEL_ERR=y
CONFIG_INPUT=y
# By default, the input thread has the same (lowest) priority as the log
# thread. While a debug image was being sent (~0.3 s over the UART), it no
# longer ran and touch points were lost ("Event dropped, queue full").
# Priority higher than the log, lower than main (0).
CONFIG_INPUT_THREAD_PRIORITY_OVERRIDE=y
CONFIG_INPUT_THREAD_PRIORITY=5

# LVGL (the pointer is created automatically from the DTS "zephyr,touch")
CONFIG_LVGL=y
CONFIG_LV_Z_MEM_POOL_SIZE=32768
CONFIG_LV_USE_LOG=y
CONFIG_LV_USE_LABEL=y
CONFIG_LV_USE_BUTTON=y
CONFIG_LV_USE_CANVAS=y
CONFIG_LV_USE_IMAGE=y
# The drawing canvas is 8-bit grayscale (L8)
CONFIG_LV_DRAW_SW_SUPPORT_L8=y
CONFIG_LV_FONT_MONTSERRAT_14=y
CONFIG_LV_FONT_MONTSERRAT_24=y
# Recognized digit in large font
CONFIG_LV_FONT_MONTSERRAT_48=y
CONFIG_LV_USE_BAR=y
```

## src/main.c
```c
/*
 * digit_touch — recognition of handwritten digits drawn with a finger.
 *
 * At startup: model self-test on fixed MNIST images (step 5), then the
 * drawing UI (step 6). When the drawing is finished: 28x28 preprocessing
 * (step 7), inference, then display of the result and the confidence bars
 * (step 8). The 28x28 image is also sent to the console (debug, and data
 * collection for step 9).
 */

#include <zephyr/device.h>
#include <zephyr/devicetree.h>
#include <zephyr/drivers/display.h>
#include <zephyr/kernel.h>
#include <zephyr/logging/log.h>
#include <lvgl.h>

#include "inference.h"
#include "preprocess.h"
#include "selftest.h"
#include "ui.h"

LOG_MODULE_REGISTER(app, LOG_LEVEL_INF);

/* Below 75 % for the most likely digit, "?" is displayed.
 * The model has no "this is not a digit" class: it always answers one of
 * the 10. A low confidence signals an ambiguous drawing.
 * Tuned from testing: 60 % let through a "∠" read as 4 at 73 % and a
 * French-style "1" read as 1 at 64 % (vs 7 at 34 %). The correct answers
 * were all above 93 %.
 */
#define CONFIDENCE_THRESHOLD_PERMILLE 750

static bool model_ready;

/* Called by the UI when the drawing is finished */
static void on_drawing_done(void)
{
	static uint8_t img[MNIST_SIZE * MNIST_SIZE];
	static int8_t input[MNIST_SIZE * MNIST_SIZE];
	const struct inference_quant *q = inference_get_quant();
	int8_t scores[INFERENCE_NUM_CLASSES];
	struct ink_bbox bbox;
	uint32_t t0, t1, t2;
	int order[INFERENCE_NUM_CLASSES];
	int permille[INFERENCE_NUM_CLASSES];
	bool sure;

	if (!model_ready || !ui_drawing_bbox(&bbox)) {
		return;
	}

	t0 = k_cycle_get_32();
	preprocess_drawing(ui_drawing(), &bbox, img);
	preprocess_quantize(img, input, q);
	t1 = k_cycle_get_32();
	if (inference_run(input, scores) != 0) {
		LOG_ERR("inference failed");
		return;
	}
	t2 = k_cycle_get_32();

	/* Classes sorted by decreasing score (insertion sort, 10 elements) */
	for (int i = 0; i < INFERENCE_NUM_CLASSES; i++) {
		int j = i;

		while (j > 0 && scores[order[j - 1]] < scores[i]) {
			order[j] = order[j - 1];
			j--;
		}
		order[j] = i;
	}

	/* Probabilities in thousandths: real = scale * (q - zero_point) */
	for (int i = 0; i < INFERENCE_NUM_CLASSES; i++) {
		permille[i] = (int)((scores[i] - q->out_zero_point) * q->out_scale * 1000.0f + 0.5f);
	}
	sure = permille[order[0]] >= CONFIDENCE_THRESHOLD_PERMILLE;

	ui_show_result(permille, order[0], order[1], sure);
	preprocess_dump(img, order[0]);

	LOG_INF("prediction: %d (%d.%d %%)   then %d (%d.%d %%), %d (%d.%d %%)%s", order[0],
		permille[order[0]] / 10, permille[order[0]] % 10, order[1],
		permille[order[1]] / 10, permille[order[1]] % 10, order[2],
		permille[order[2]] / 10, permille[order[2]] % 10, sure ? "" : "  -> shown \"?\"");
	LOG_INF("ink %dx%d px | preprocessing %u us, inference %u us",
		bbox.x_max - bbox.x_min + 1, bbox.y_max - bbox.y_min + 1,
		k_cyc_to_us_near32(t1 - t0), k_cyc_to_us_near32(t2 - t1));
}

int main(void)
{
	const struct device *display_dev = DEVICE_DT_GET(DT_CHOSEN(zephyr_display));

	if (inference_init() == 0) {
		model_selftest();
		model_ready = true;
	} else {
		LOG_ERR("model initialization failed");
	}

	if (!device_is_ready(display_dev)) {
		LOG_ERR("display not ready");
		return 0;
	}

	ui_init(on_drawing_done);
	lv_timer_handler();
	display_blanking_off(display_dev);

	while (1) {
		uint32_t sleep_ms = lv_timer_handler();

		k_msleep(MIN(sleep_ms, 10));
	}

	return 0;
}
```

## src/inference.cc
```c
/*
 * digit_touch — TensorFlow Lite Micro inference engine.
 *
 * TFLM uses no dynamic allocation: all computed tensors (activations) are
 * placed in a static array, the "tensor arena".
 * The weights stay in flash, in g_model_data.
 */

#include "inference.h"
#include "model_data.h"

#include <errno.h>
#include <string.h>

#include <tensorflow/lite/micro/micro_interpreter.h>
#include <tensorflow/lite/micro/micro_mutable_op_resolver.h>
#include <tensorflow/lite/micro/micro_profiler_interface.h>
#include <tensorflow/lite/schema/schema_generated.h>

#include <zephyr/kernel.h>
#include <zephyr/linker/section_tags.h>
#include <zephyr/logging/log.h>

LOG_MODULE_REGISTER(inference, LOG_LEVEL_INF);

#if defined(CONFIG_APP_ARENA_IN_DTCM)
/* DTCM: core-coupled RAM (0x20000000), no wait states, no cache */
#define ARENA_SECTION __dtcm_noinit_section
#else
#define ARENA_SECTION
#endif

namespace {

/* Measured on the board: 9924 B used with CMSIS-NN, 9812 B without.
 * 12 KB leaves ~20 % headroom.
 */
constexpr size_t kArenaSize = 12 * 1024;
uint8_t tensor_arena[kArenaSize] __attribute__((aligned(16))) ARENA_SECTION;

#if defined(CONFIG_APP_LAYER_PROFILING)
/* TFLM calls BeginEvent()/EndEvent() around each operation of the model.
 * We simply measure the elapsed CPU cycles there.
 */
class CycleProfiler : public tflite::MicroProfilerInterface {
public:
	static constexpr int kMaxEvents = 16;

	uint32_t BeginEvent(const char *tag) override
	{
		if (count_ >= kMaxEvents) {
			return kMaxEvents;
		}
		events_[count_].op = tag;
		start_[count_] = k_cycle_get_32();
		return count_++;
	}

	void EndEvent(uint32_t handle) override
	{
		if (handle < kMaxEvents) {
			events_[handle].cycles = k_cycle_get_32() - start_[handle];
		}
	}

	void Reset() { count_ = 0; }

	int Copy(struct inference_layer_time *out, int max) const
	{
		int n = MIN(count_, max);

		memcpy(out, events_, n * sizeof(events_[0]));
		return n;
	}

private:
	struct inference_layer_time events_[kMaxEvents];
	uint32_t start_[kMaxEvents];
	int count_ = 0;
};

CycleProfiler profiler;
#define PROFILER (&profiler)
#else
#define PROFILER nullptr
#endif

/* Only the 5 operations of the model (see train/out/quant.json):
 * the linker does not pull in the code of the others.
 */
using OpResolver = tflite::MicroMutableOpResolver<5>;

tflite::MicroInterpreter *interpreter;
TfLiteTensor *input;
TfLiteTensor *output;
struct inference_quant quant;

} /* namespace */

extern "C" int inference_init(void)
{
	const tflite::Model *model = tflite::GetModel(g_model_data);

	if (model->version() != TFLITE_SCHEMA_VERSION) {
		LOG_ERR("schema version %lu, expected %d",
			(unsigned long)model->version(), TFLITE_SCHEMA_VERSION);
		return -EINVAL;
	}

	static OpResolver resolver;
	resolver.AddConv2D();
	resolver.AddMaxPool2D();
	resolver.AddReshape();
	resolver.AddFullyConnected();
	resolver.AddSoftmax();

	static tflite::MicroInterpreter static_interpreter(model, resolver, tensor_arena,
							   kArenaSize, nullptr, PROFILER);
	interpreter = &static_interpreter;

	if (interpreter->AllocateTensors() != kTfLiteOk) {
		LOG_ERR("AllocateTensors() failed: %u B arena too small?",
			(unsigned)kArenaSize);
		return -ENOMEM;
	}

	input = interpreter->input(0);
	output = interpreter->output(0);

	/* Check that the model is the one the rest of the code expects */
	if (input->type != kTfLiteInt8 || input->bytes != INFERENCE_IMAGE_SIZE ||
	    output->type != kTfLiteInt8 || output->bytes != INFERENCE_NUM_CLASSES) {
		LOG_ERR("unexpected input/output shape or type");
		return -EINVAL;
	}

	quant.in_scale = input->params.scale;
	quant.in_zero_point = input->params.zero_point;
	quant.out_scale = output->params.scale;
	quant.out_zero_point = output->params.zero_point;

	return 0;
}

extern "C" int inference_run(const int8_t *image, int8_t *scores)
{
	memcpy(input->data.int8, image, INFERENCE_IMAGE_SIZE);

#if defined(CONFIG_APP_LAYER_PROFILING)
	profiler.Reset();
#endif
	if (interpreter->Invoke() != kTfLiteOk) {
		return -EIO;
	}

	memcpy(scores, output->data.int8, INFERENCE_NUM_CLASSES);
	return 0;
}

extern "C" size_t inference_arena_used(void)
{
	return interpreter->arena_used_bytes();
}

extern "C" size_t inference_arena_size(void)
{
	return kArenaSize;
}

extern "C" const struct inference_quant *inference_get_quant(void)
{
	return &quant;
}

extern "C" int inference_last_profile(struct inference_layer_time *out, int max)
{
#if defined(CONFIG_APP_LAYER_PROFILING)
	return profiler.Copy(out, max);
#else
	ARG_UNUSED(out);
	ARG_UNUSED(max);
	return 0;
#endif
}

extern "C" const void *inference_arena_addr(void)
{
	return tensor_arena;
}
```

## src/inference.h
```c
/*
 * digit_touch — C interface of the inference engine (TFLM, implemented in C++).
 */

#ifndef INFERENCE_H_
#define INFERENCE_H_

#include <stddef.h>
#include <stdint.h>

#ifdef __cplusplus
extern "C" {
#endif

#define INFERENCE_IMAGE_SIZE  (28 * 28)
#define INFERENCE_NUM_CLASSES 10

/* int8 <-> real conversion rule: real = scale * (q - zero_point) */
struct inference_quant {
	float in_scale;
	int in_zero_point;
	float out_scale;
	int out_zero_point;
};

/* Load the model and reserve its memory in the arena. 0 on success. */
int inference_init(void);

/* image: 28x28 int8 (-128 = black, 127 = white)
 * scores: 10 int8 outputs (quantized probabilities). 0 on success.
 */
int inference_run(const int8_t *image, int8_t *scores);

/* Arena bytes actually used (known after inference_init) */
size_t inference_arena_used(void);
size_t inference_arena_size(void);

const struct inference_quant *inference_get_quant(void);

/* Time spent in one operation during the last inference */
struct inference_layer_time {
	const char *op;   /* TFLite name: "CONV_2D", "MAX_POOL_2D"... */
	uint32_t cycles;
};

/* Copy the profile of the last inference (CONFIG_APP_LAYER_PROFILING).
 * Returns the number of operations, 0 if profiling is disabled.
 */
int inference_last_profile(struct inference_layer_time *out, int max);

/* Arena address, to know which memory it lives in */
const void *inference_arena_addr(void);

#ifdef __cplusplus
}
#endif

#endif /* INFERENCE_H_ */
```

## src/model_data.h
```c
/*
 * digit_touch int8 CNN model — FILE GENERATED by train/quantize.py, do not edit.
 *
 * Input      : int8 [1][28][28][1], scale=0.00392157 zero_point=-128
 * Output     : int8 [1][10],        scale=0.00390625 zero_point=-128
 * Operations : CONV_2D, FULLY_CONNECTED, MAX_POOL_2D, RESHAPE, SOFTMAX
 */

#ifndef MODEL_DATA_H_
#define MODEL_DATA_H_

#ifdef __cplusplus
extern "C" {
#endif

extern const unsigned char g_model_data[];
extern const unsigned int g_model_data_len;

#ifdef __cplusplus
}
#endif

#endif /* MODEL_DATA_H_ */
```

## src/preprocess.c
```c
/*
 * digit_touch — preprocessing: 252x252 drawing -> MNIST-style 28x28 image.
 *
 * The model has only seen MNIST digits, all prepared the same way:
 *   1. the digit is scaled down to fit in a 20x20 pixel box, keeping its
 *      aspect ratio, with anti-aliasing (grayscale edges);
 *   2. this box is placed in a 28x28 image so that the CENTER OF MASS
 *      (center of gravity of the ink) falls at the center of the image.
 * We reproduce exactly these two operations on the finger drawing.
 */

#include "preprocess.h"

#include <math.h>
#include <string.h>
#include <zephyr/kernel.h>
#include <zephyr/sys/printk.h>

/* Value of a drawing pixel, 0 (black) outside the area */
static inline uint32_t ink_at(const uint8_t *ink, int x, int y)
{
	if (x < 0 || y < 0 || x >= DRAW_SIZE || y >= DRAW_SIZE) {
		return 0;
	}
	return ink[y * DRAW_SIZE + x];
}

/* Step 1: bounding box -> 20x20 box.
 *
 * We take a SQUARE whose side = the longest side of the bounding box,
 * centered on it: a "1" (tall and narrow) stays narrow instead of being
 * stretched horizontally. This square is split into 20x20 cells; each output
 * pixel is the AVERAGE of the pixels in its cell ("box" filter). A 17 px
 * stroke scaled down by a factor of ~7 gives ~2-3 px with gray edges: that
 * is MNIST's anti-aliasing.
 */
static void fit_box(const uint8_t *ink, const struct ink_bbox *bb,
		    uint8_t box[MNIST_BOX * MNIST_BOX])
{
	int w = bb->x_max - bb->x_min + 1;
	int h = bb->y_max - bb->y_min + 1;
	int side = MAX(w, h);
	/* Top-left corner of the square centered on the bounding box */
	int x0 = bb->x_min + (w - side) / 2;
	int y0 = bb->y_min + (h - side) / 2;

	for (int oy = 0; oy < MNIST_BOX; oy++) {
		int sy0 = y0 + oy * side / MNIST_BOX;
		int sy1 = MAX(y0 + (oy + 1) * side / MNIST_BOX, sy0 + 1);

		for (int ox = 0; ox < MNIST_BOX; ox++) {
			int sx0 = x0 + ox * side / MNIST_BOX;
			int sx1 = MAX(x0 + (ox + 1) * side / MNIST_BOX, sx0 + 1);
			uint32_t sum = 0;

			for (int y = sy0; y < sy1; y++) {
				for (int x = sx0; x < sx1; x++) {
					sum += ink_at(ink, x, y);
				}
			}
			box[oy * MNIST_BOX + ox] = sum / ((sx1 - sx0) * (sy1 - sy0));
		}
	}
}

/* Step 2: place the 20x20 box in the 28x28 image, centered on its center
 * of mass.
 *
 * Center of mass = average of the pixel positions, weighted by their
 * intensity. Example: a "7" has a lot of ink at the top (the bar), so its
 * center of mass is higher than the center of its box. Bringing it back to
 * the center moves the 7 down a little, exactly as in MNIST.
 */
static void center_of_mass(const uint8_t box[MNIST_BOX * MNIST_BOX],
			   uint8_t out[MNIST_SIZE * MNIST_SIZE])
{
	uint32_t total = 0, sx = 0, sy = 0;
	int dx, dy;

	for (int y = 0; y < MNIST_BOX; y++) {
		for (int x = 0; x < MNIST_BOX; x++) {
			uint32_t v = box[y * MNIST_BOX + x];

			total += v;
			sx += v * x;
			sy += v * y;
		}
	}

	if (total == 0) {
		dx = dy = (MNIST_SIZE - MNIST_BOX) / 2;
	} else {
		/* Offset that brings the center of mass to the center (14, 14) */
		dx = (int)lroundf(MNIST_SIZE / 2.0f - (float)sx / total);
		dy = (int)lroundf(MNIST_SIZE / 2.0f - (float)sy / total);
		/* Keep the box entirely inside the image */
		dx = CLAMP(dx, 0, MNIST_SIZE - MNIST_BOX);
		dy = CLAMP(dy, 0, MNIST_SIZE - MNIST_BOX);
	}

	memset(out, 0, MNIST_SIZE * MNIST_SIZE);
	for (int y = 0; y < MNIST_BOX; y++) {
		memcpy(&out[(y + dy) * MNIST_SIZE + dx], &box[y * MNIST_BOX], MNIST_BOX);
	}
}

void preprocess_drawing(const uint8_t *ink, const struct ink_bbox *bbox,
			uint8_t out[MNIST_SIZE * MNIST_SIZE])
{
	uint8_t box[MNIST_BOX * MNIST_BOX];

	fit_box(ink, bbox, box);
	center_of_mass(box, out);
}

void preprocess_quantize(const uint8_t in[MNIST_SIZE * MNIST_SIZE],
			 int8_t out[MNIST_SIZE * MNIST_SIZE], const struct inference_quant *q)
{
	/* During training: real pixel = byte / 255.
	 * int8 conversion: q = round(real / scale) + zero_point.
	 * With scale = 1/255 and zero_point = -128, this amounts to byte - 128.
	 */
	for (int i = 0; i < MNIST_SIZE * MNIST_SIZE; i++) {
		int v = (int)lroundf(in[i] / 255.0f / q->in_scale) + q->in_zero_point;

		out[i] = (int8_t)CLAMP(v, -128, 127);
	}
}

/* With CONFIG_LOG_PRINTK, each printk() becomes a log message: so each whole
 * line is built before being sent in a single call (one printk per
 * character overflowed the log buffer).
 */
void preprocess_dump(const uint8_t img[MNIST_SIZE * MNIST_SIZE], int pred)
{
	static const char shades[] = " .:-=+*#%@";
	static const char hex[] = "0123456789abcdef";
	static char line[2 * MNIST_SIZE * MNIST_SIZE + 1];

	printk("+----------------------------------------------------------+\n");
	for (int y = 0; y < MNIST_SIZE; y++) {
		for (int x = 0; x < MNIST_SIZE; x++) {
			char c = shades[img[y * MNIST_SIZE + x] * (sizeof(shades) - 2) / 255];

			/* 2 characters per pixel: the image is not squashed horizontally */
			line[2 * x] = c;
			line[2 * x + 1] = c;
		}
		line[2 * MNIST_SIZE] = '\0';
		printk("| %s |\n", line);
	}
	printk("+----------------------------------------------------------+\n");

	for (int i = 0; i < MNIST_SIZE * MNIST_SIZE; i++) {
		line[2 * i] = hex[img[i] >> 4];
		line[2 * i + 1] = hex[img[i] & 0xf];
	}
	line[2 * MNIST_SIZE * MNIST_SIZE] = '\0';
	printk("IMG:%d:%s\n", pred, line);
}
```

## src/preprocess.h
```c
/*
 * digit_touch — preprocessing: 252x252 drawing -> MNIST-style 28x28 image.
 */

#ifndef PREPROCESS_H_
#define PREPROCESS_H_

#include <stdint.h>

#include "inference.h"
#include "ui.h"

#define MNIST_SIZE 28
#define MNIST_BOX  20 /* MNIST: the digit fits in a 20x20 box */

/* Crop, scale down and center the drawing like the MNIST digits.
 * ink  : DRAW_SIZE x DRAW_SIZE bytes (0 = black, 255 = white)
 * bbox : bounding box of the ink
 * out  : 28x28 grayscale image 0..255
 */
void preprocess_drawing(const uint8_t *ink, const struct ink_bbox *bbox,
			uint8_t out[MNIST_SIZE * MNIST_SIZE]);

/* 0..255 -> int8 according to the model's input conversion rule */
void preprocess_quantize(const uint8_t in[MNIST_SIZE * MNIST_SIZE],
			 int8_t out[MNIST_SIZE * MNIST_SIZE], const struct inference_quant *q);

/* Debug: print the 28x28 image as ASCII on the console, then a line
 * "IMG:<784 bytes in hex>" readable by train/view_digits.py.
 */
void preprocess_dump(const uint8_t img[MNIST_SIZE * MNIST_SIZE], int pred);

#endif /* PREPROCESS_H_ */
```

## src/selftest.c
```c
/*
 * digit_touch — model self-test on fixed MNIST images.
 *
 * For each image in test_images.c:
 *  - run inference on the board;
 *  - compare the 10 int8 scores with those computed on the PC (they must be
 *    byte-for-byte identical: same model, same inputs, same integer
 *    arithmetic);
 * then measure the average time of one inference.
 */

#include "selftest.h"
#include "inference.h"
#include "test_images.h"

#include <string.h>
#include <zephyr/kernel.h>
#include <zephyr/logging/log.h>

LOG_MODULE_REGISTER(selftest, LOG_LEVEL_INF);

#define BENCH_RUNS 100

static int argmax(const int8_t *scores)
{
	int best = 0;

	for (int i = 1; i < INFERENCE_NUM_CLASSES; i++) {
		if (scores[i] > scores[best]) {
			best = i;
		}
	}
	return best;
}

/* Probability in tenths of a %: real = (q - zero_point) * scale, here scale = 1/256 */
static int score_permille(int8_t q, const struct inference_quant *qp)
{
	return (int)((q - qp->out_zero_point) * qp->out_scale * 1000.0f + 0.5f);
}

int model_selftest(void)
{
	const struct inference_quant *qp = inference_get_quant();
	int8_t scores[INFERENCE_NUM_CLASSES];
	int differences = 0;
	uint32_t start, cycles;

	LOG_INF("--- self-test: %d MNIST images ---", TEST_IMAGE_COUNT);

	for (int i = 0; i < TEST_IMAGE_COUNT; i++) {
		if (inference_run(test_images[i], scores) != 0) {
			LOG_ERR("image %d: inference failed", i);
			differences++;
			continue;
		}

		int pred = argmax(scores);
		int pm = score_permille(scores[pred], qp);
		bool same = memcmp(scores, test_expected[i], sizeof(scores)) == 0;

		if (!same) {
			differences++;
		}

		LOG_INF("image %2d: true %u, predicted %d (%3d.%d %%)  %s%s", i, test_labels[i], pred,
			pm / 10, pm % 10, same ? "== PC" : "!= PC",
			pred == test_labels[i] ? "" : "  [model error]");
	}

	/* Timing: average over BENCH_RUNS inferences.
	 * k_cycle_get_32() counts CPU cycles (216 MHz on the F746).
	 */
	start = k_cycle_get_32();
	for (int r = 0; r < BENCH_RUNS; r++) {
		inference_run(test_images[0], scores);
	}
	cycles = (k_cycle_get_32() - start) / BENCH_RUNS;

	LOG_INF("config: %s, CMSIS-NN %s, arena in %s (%p)",
		IS_ENABLED(CONFIG_SPEED_OPTIMIZATIONS) ? "-O2" : "-Os",
		IS_ENABLED(CONFIG_TENSORFLOW_LITE_MICRO_CMSIS_NN_KERNELS) ? "yes" : "no",
		IS_ENABLED(CONFIG_APP_ARENA_IN_DTCM) ? "DTCM" : "SRAM", inference_arena_addr());
	LOG_INF("inference time: %u cycles = %u us (average over %d)", cycles,
		(uint32_t)k_cyc_to_us_near32(cycles), BENCH_RUNS);
	LOG_INF("arena: %u / %u bytes used", (unsigned)inference_arena_used(),
		(unsigned)inference_arena_size());

	/* Profile of the last benchmark inference: where does the time go? */
	struct inference_layer_time layers[16];
	int n = inference_last_profile(layers, ARRAY_SIZE(layers));
	uint32_t total = 0;

	for (int i = 0; i < n; i++) {
		total += layers[i].cycles;
	}
	for (int i = 0; i < n; i++) {
		LOG_INF("  layer %d %-16s %8u cycles %6u us %3u %%", i, layers[i].op,
			layers[i].cycles, (uint32_t)k_cyc_to_us_near32(layers[i].cycles),
			total ? (uint32_t)((uint64_t)layers[i].cycles * 100 / total) : 0);
	}
	LOG_INF("--- result: %d/%d outputs identical to PC ---",
		TEST_IMAGE_COUNT - differences, TEST_IMAGE_COUNT);

	return differences;
}
```

## src/selftest.h
```c
/*
 * digit_touch — model self-test on fixed MNIST images.
 */

#ifndef SELFTEST_H_
#define SELFTEST_H_

/* Compare the board's outputs with the PC's and measure the inference time.
 * Returns the number of images whose output differs from the PC.
 */
int model_selftest(void);

#endif /* SELFTEST_H_ */
```

## src/test_images.h
```c
/*
 * MNIST test images — FILE GENERATED by train/export_samples.py.
 *
 * Indices in the MNIST test set: [3, 2, 1, 18, 4, 8, 11, 0, 61, 7, 78, 321]
 * The last 2 are images the model gets wrong (on the PC too).
 */

#ifndef TEST_IMAGES_H_
#define TEST_IMAGES_H_

#include <stdint.h>

#define TEST_IMAGE_COUNT 12

/* Already quantized images (int8, -128 = black, 127 = white), 28x28 row by row */
extern const int8_t test_images[TEST_IMAGE_COUNT][28 * 28];
/* True digit of each image */
extern const uint8_t test_labels[TEST_IMAGE_COUNT];
/* Exact int8 output of the model on the PC, to be matched byte for byte on the board */
extern const int8_t test_expected[TEST_IMAGE_COUNT][10];

#endif /* TEST_IMAGES_H_ */
```

## src/ui.c
```c
/*
 * digit_touch — LVGL UI: drawing area + Clear button.
 *
 * Drawing is done directly into an 8-bit array (ink[]) that we fully
 * control: white stroke on a black background, like MNIST. LVGL only
 * displays it, through an L8 (8-bit luminance) canvas that uses this same
 * array as its buffer. Preprocessing reads ink[] directly, without
 * going through LVGL.
 */

#include "ui.h"

#include <stdlib.h>
#include <string.h>
#include <zephyr/kernel.h>
#include <zephyr/logging/log.h>
#include <lvgl.h>

LOG_MODULE_REGISTER(ui, LOG_LEVEL_INF);

/* Brush radius in screen pixels. A digit drawn ~180 px tall with a ~17 px
 * stroke roughly keeps the MNIST proportions (2-3 px stroke for a 20 px
 * digit).
 */
#define BRUSH_RADIUS 8
#define CANVAS_X     10
#define CANVAS_Y     10

/* Results panel, to the right of the drawing area (480x272 screen) */
#define PANEL_X   278
#define BARS_Y    82
#define BAR_PITCH 14
#define BAR_W     120
#define BAR_H     8

static uint8_t ink[DRAW_SIZE * DRAW_SIZE] __aligned(4);

static lv_obj_t *canvas;
static lv_obj_t *digit_label;
static lv_obj_t *pct_label;
static lv_obj_t *status_label;
static lv_obj_t *bars[INFERENCE_NUM_CLASSES];
static lv_obj_t *bar_pct[INFERENCE_NUM_CLASSES];

/* Time the last result was displayed (automatic clearing) */
static bool result_shown;
static int64_t result_time_ms;

/* End of drawing: timer restarted on every stroke */
static lv_timer_t *done_timer;
static ui_drawing_done_cb_t drawing_done_cb;

/* State of the current stroke */
static bool stroke_active;
static int16_t last_x, last_y;
static uint32_t stroke_count;

/* Bounding box of all the ink */
static bool has_ink;
static struct ink_bbox bbox;

/* ------------------------------------------------------------------------ */
/* Drawing into ink[]                                                       */
/* ------------------------------------------------------------------------ */

/* Filled disk of radius BRUSH_RADIUS centered at (cx, cy), clipped at the edges */
static void stamp_disk(int cx, int cy)
{
	for (int dy = -BRUSH_RADIUS; dy <= BRUSH_RADIUS; dy++) {
		int y = cy + dy;

		if (y < 0 || y >= DRAW_SIZE) {
			continue;
		}
		for (int dx = -BRUSH_RADIUS; dx <= BRUSH_RADIUS; dx++) {
			int x = cx + dx;

			if (x >= 0 && x < DRAW_SIZE &&
			    dx * dx + dy * dy <= BRUSH_RADIUS * BRUSH_RADIUS) {
				ink[y * DRAW_SIZE + x] = 255;
			}
		}
	}
}

/* The touch panel only reports one point every ~10-20 ms: on a fast
 * gesture, two successive points can be 20-30 px apart. So the points are
 * joined by stamping the brush at every pixel along the segment, otherwise
 * the stroke would be a series of separate dots.
 */
static void draw_segment(int x0, int y0, int x1, int y1)
{
	int dx = x1 - x0;
	int dy = y1 - y0;
	int steps = MAX(abs(dx), abs(dy));
	lv_area_t c, area;

	if (steps == 0) {
		stamp_disk(x0, y0);
	} else {
		for (int i = 0; i <= steps; i++) {
			stamp_disk(x0 + dx * i / steps, y0 + dy * i / steps);
		}
	}

	/* Total ink, clamped to the drawing area */
	int xmin = CLAMP(MIN(x0, x1) - BRUSH_RADIUS, 0, DRAW_SIZE - 1);
	int xmax = CLAMP(MAX(x0, x1) + BRUSH_RADIUS, 0, DRAW_SIZE - 1);
	int ymin = CLAMP(MIN(y0, y1) - BRUSH_RADIUS, 0, DRAW_SIZE - 1);
	int ymax = CLAMP(MAX(y0, y1) + BRUSH_RADIUS, 0, DRAW_SIZE - 1);

	if (!has_ink) {
		bbox = (struct ink_bbox){xmin, ymin, xmax, ymax};
		has_ink = true;
	} else {
		bbox.x_min = MIN(bbox.x_min, xmin);
		bbox.y_min = MIN(bbox.y_min, ymin);
		bbox.x_max = MAX(bbox.x_max, xmax);
		bbox.y_max = MAX(bbox.y_max, ymax);
	}

	/* Redraw on screen only the small modified area (screen coordinates) */
	lv_obj_get_coords(canvas, &c);
	area.x1 = c.x1 + xmin;
	area.y1 = c.y1 + ymin;
	area.x2 = c.x1 + xmax;
	area.y2 = c.y1 + ymax;
	lv_obj_invalidate_area(canvas, &area);
}

/* Empty results panel: prompt to draw, bars at zero */
static void clear_result(void)
{
	result_shown = false;
	lv_label_set_text(digit_label, "-");
	lv_obj_set_style_text_color(digit_label, lv_palette_main(LV_PALETTE_GREY), 0);
	lv_label_set_text(pct_label, "");
	lv_label_set_text(status_label, "Draw a digit");

	for (int i = 0; i < INFERENCE_NUM_CLASSES; i++) {
		lv_bar_set_value(bars[i], 0, LV_ANIM_ON);
		lv_obj_set_style_bg_color(bars[i], lv_palette_main(LV_PALETTE_BLUE_GREY),
					  LV_PART_INDICATOR);
		lv_label_set_text(bar_pct[i], "");
	}
}

static void clear_drawing(void)
{
	memset(ink, 0, sizeof(ink));
	has_ink = false;
	stroke_active = false;
	stroke_count = 0;
	lv_timer_pause(done_timer);
	lv_obj_invalidate(canvas);
	clear_result();
}

void ui_show_result(const int permille[INFERENCE_NUM_CLASSES], int best, int second, bool sure)
{
	/* Green if the model is confident, orange otherwise */
	lv_color_t accent = lv_palette_main(sure ? LV_PALETTE_GREEN : LV_PALETTE_ORANGE);

	result_shown = true;
	result_time_ms = k_uptime_get();

	if (sure) {
		lv_label_set_text_fmt(digit_label, "%d", best);
		lv_label_set_text(status_label, "Recognized");
	} else {
		lv_label_set_text(digit_label, "?");
		lv_label_set_text_fmt(status_label, "Not sure: %d or %d?", best, second);
	}
	lv_obj_set_style_text_color(digit_label, accent, 0);
	lv_label_set_text_fmt(pct_label, "%d %%", (permille[best] + 5) / 10);

	for (int i = 0; i < INFERENCE_NUM_CLASSES; i++) {
		lv_bar_set_value(bars[i], permille[i], LV_ANIM_ON);
		lv_obj_set_style_bg_color(bars[i],
					  i == best ? accent
						    : lv_palette_main(LV_PALETTE_BLUE_GREY),
					  LV_PART_INDICATOR);
		lv_label_set_text_fmt(bar_pct[i], "%d %%", (permille[i] + 5) / 10);
	}
}

/* ------------------------------------------------------------------------ */
/* Events                                                                   */
/* ------------------------------------------------------------------------ */

static void canvas_event_cb(lv_event_t *e)
{
	lv_event_code_t code = lv_event_get_code(e);
	lv_point_t p;
	lv_area_t c;

	/* New digit started while the previous one is displayed: clear */
	if (code == LV_EVENT_PRESSED && result_shown &&
	    k_uptime_get() - result_time_ms >= AUTO_CLEAR_DELAY_MS) {
		clear_drawing();
		LOG_INF("new digit: drawing cleared automatically");
	}

	switch (code) {
	case LV_EVENT_PRESSED:
	case LV_EVENT_PRESSING:
		lv_indev_get_point(lv_indev_active(), &p);
		lv_obj_get_coords(canvas, &c);
		/* Coordinates relative to the drawing area. No clamping: a finger
		 * that leaves the area and comes back keeps a continuous stroke,
		 * stamp_disk() simply clips whatever lies outside.
		 */
		p.x -= c.x1;
		p.y -= c.y1;

		if (code == LV_EVENT_PRESSED || !stroke_active) {
			/* New stroke: the drawing is not finished */
			lv_timer_pause(done_timer);
			stroke_active = true;
			stroke_count++;
			draw_segment(p.x, p.y, p.x, p.y);
		} else {
			draw_segment(last_x, last_y, p.x, p.y);
		}
		last_x = p.x;
		last_y = p.y;
		break;

	case LV_EVENT_RELEASED:
	case LV_EVENT_PRESS_LOST:
		if (stroke_active) {
			stroke_active = false;
			LOG_INF("stroke %u done, ink x=[%d..%d] y=[%d..%d]", stroke_count,
				bbox.x_min, bbox.x_max, bbox.y_min, bbox.y_max);
			/* If no stroke starts within DRAWING_DONE_DELAY_MS, it is finished */
			lv_timer_reset(done_timer);
			lv_timer_resume(done_timer);
		}
		break;

	default:
		break;
	}
}

static void done_timer_cb(lv_timer_t *t)
{
	lv_timer_pause(t);
	if (drawing_done_cb != NULL && has_ink) {
		drawing_done_cb();
	}
}

static void clear_btn_cb(lv_event_t *e)
{
	ARG_UNUSED(e);
	clear_drawing();
	LOG_INF("drawing cleared");
}

/* ------------------------------------------------------------------------ */
/* Screen construction                                                      */
/* ------------------------------------------------------------------------ */

void ui_init(ui_drawing_done_cb_t done_cb)
{
	lv_obj_t *scr = lv_screen_active();
	lv_obj_t *btn, *btn_label;

	drawing_done_cb = done_cb;
	done_timer = lv_timer_create(done_timer_cb, DRAWING_DONE_DELAY_MS, NULL);
	lv_timer_pause(done_timer);

	lv_obj_set_style_bg_color(scr, lv_color_hex(0x202020), 0);
	lv_obj_set_scrollable(scr, false);

	/* Drawing area: L8 canvas whose buffer is ink[] */
	if (lv_draw_buf_width_to_stride(DRAW_SIZE, LV_COLOR_FORMAT_L8) != DRAW_SIZE) {
		LOG_ERR("unexpected L8 stride: check CONFIG_LV_DRAW_BUF_STRIDE_ALIGN");
	}
	canvas = lv_canvas_create(scr);
	lv_canvas_set_buffer(canvas, ink, DRAW_SIZE, DRAW_SIZE, LV_COLOR_FORMAT_L8);
	lv_obj_set_pos(canvas, CANVAS_X, CANVAS_Y);
	lv_obj_set_style_outline_width(canvas, 2, 0);
	lv_obj_set_style_outline_color(canvas, lv_palette_main(LV_PALETTE_GREY), 0);
	/* A canvas (image) is not clickable by default */
	lv_obj_set_clickable(canvas, true);
	lv_obj_add_event_cb(canvas, canvas_event_cb, LV_EVENT_ALL, NULL);

	/* Right panel: result */
	digit_label = lv_label_create(scr);
	lv_obj_set_style_text_font(digit_label, &lv_font_montserrat_48, 0);
	lv_obj_set_pos(digit_label, PANEL_X + 4, 0);

	pct_label = lv_label_create(scr);
	lv_obj_set_style_text_font(pct_label, &lv_font_montserrat_24, 0);
	lv_obj_set_pos(pct_label, PANEL_X + 60, 14);

	status_label = lv_label_create(scr);
	lv_obj_set_style_text_color(status_label, lv_palette_lighten(LV_PALETTE_GREY, 2), 0);
	lv_obj_set_pos(status_label, PANEL_X + 4, 54);

	/* One confidence bar per digit: "N [=====    ] xx %" */
	for (int i = 0; i < INFERENCE_NUM_CLASSES; i++) {
		int y = BARS_Y + i * BAR_PITCH;
		lv_obj_t *name = lv_label_create(scr);

		lv_obj_set_style_text_color(name, lv_color_white(), 0);
		lv_label_set_text_fmt(name, "%d", i);
		lv_obj_set_pos(name, PANEL_X + 4, y - 4);

		bars[i] = lv_bar_create(scr);
		lv_bar_set_range(bars[i], 0, 1000);
		lv_obj_set_size(bars[i], BAR_W, BAR_H);
		lv_obj_set_pos(bars[i], PANEL_X + 20, y);
		lv_obj_set_style_bg_color(bars[i], lv_color_hex(0x404040), LV_PART_MAIN);
		lv_obj_set_style_bg_opa(bars[i], LV_OPA_COVER, LV_PART_MAIN);
		lv_obj_set_style_anim_duration(bars[i], 250, 0);

		bar_pct[i] = lv_label_create(scr);
		lv_obj_set_style_text_color(bar_pct[i], lv_palette_lighten(LV_PALETTE_GREY, 2), 0);
		lv_obj_set_width(bar_pct[i], 44);
		lv_obj_set_style_text_align(bar_pct[i], LV_TEXT_ALIGN_RIGHT, 0);
		lv_obj_set_pos(bar_pct[i], PANEL_X + 20 + BAR_W + 2, y - 4);
	}

	btn = lv_button_create(scr);
	lv_obj_set_size(btn, 185, 40);
	lv_obj_set_pos(btn, PANEL_X + 4, 227);
	lv_obj_add_event_cb(btn, clear_btn_cb, LV_EVENT_CLICKED, NULL);
	btn_label = lv_label_create(btn);
	lv_obj_set_style_text_font(btn_label, &lv_font_montserrat_24, 0);
	lv_label_set_text(btn_label, "Clear");
	lv_obj_center(btn_label);

	clear_drawing();
}

const uint8_t *ui_drawing(void)
{
	return ink;
}

bool ui_drawing_bbox(struct ink_bbox *out)
{
	if (has_ink) {
		*out = bbox;
	}
	return has_ink;
}
```

## src/ui.h
```c
/*
 * digit_touch — LVGL UI: drawing area + Clear button.
 */

#ifndef UI_H_
#define UI_H_

#include <stdbool.h>
#include <stdint.h>

#include "inference.h"

/* Square drawing area: 252 = 9 x 28, 8-bit grayscale
 * (0 = black, 255 = white), stored row by row.
 */
#define DRAW_SIZE 252

/* Bounding box of the ink (inclusive bounds) */
struct ink_bbox {
	int16_t x_min, y_min, x_max, y_max;
};

/* Delay without a new stroke after which the drawing is considered finished.
 * Allows drawing a 4 or a crossed 7 in several strokes.
 */
#define DRAWING_DONE_DELAY_MS 500

/* If a result has been displayed for at least this delay, touching the
 * screen starts a new digit: the drawing area is cleared first.
 * Below it, the stroke is added to the current drawing (e.g. the bar of a 7
 * added right after the result).
 */
#define AUTO_CLEAR_DELAY_MS 1000

/* Called (in the LVGL thread) when the drawing is finished */
typedef void (*ui_drawing_done_cb_t)(void);

/* Create the screen. Call once, from the thread that runs LVGL. */
void ui_init(ui_drawing_done_cb_t done_cb);

/* Display the result of a recognition.
 * permille: probability of each digit, in thousandths (0..1000)
 * best, second: the two most likely digits
 * sure: false if the confidence is too low -> displays "?"
 */
void ui_show_result(const int permille[INFERENCE_NUM_CLASSES], int best, int second, bool sure);

/* Drawn image: DRAW_SIZE x DRAW_SIZE bytes */
const uint8_t *ui_drawing(void);

/* false if nothing is drawn; otherwise fills *bbox */
bool ui_drawing_bbox(struct ink_bbox *bbox);

#endif /* UI_H_ */
```
